// SPDX-License-Identifier: GPL-2.0-only
/*
 * Copyright (C) 2023 Variscite LTD - http://www.variscite.com/
 */

#include "var-som-am33-tpm.dtsi"
#include "var-som-am33-customboard.dtsi"

&i2c1 {
	/delete-node/ edt_ft5x06_ts@38;
};
